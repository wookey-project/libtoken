## Kconfig
```kconfig
config USR_LIB_TOKEN
  select USR_LIB_SMARTCARD
  select USR_LIB_AES
  bool  "userspace Wookey javacard tokens API"
  default y
  ---help---
  Support for communication with the Wookey project applets,
  including AUTH and DFU tokens.

if USR_LIB_TOKEN

menu "libtoken specific options"

config SMARTCARD_DEBUG
  bool "Activate debuggging for smartcard interaction"
  default n
  ---help---
  Activate various debugging for smartcard interaction.
  This option activate APDU/TPDU printing on serial console.
  This option is efficient only if KERNEL_SERIAL is activated.

endmenu

endif
```
